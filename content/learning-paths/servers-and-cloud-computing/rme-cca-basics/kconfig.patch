## content/learning-paths/servers-and-cloud-computing/rme-cca-basics/kconfig.patch
```kconfig
diff --git a/arch/arm64/Kconfig b/arch/arm64/Kconfig
index 0aac44a993ac..2c311236c21a
--- a/arch/arm64/Kconfig
+++ b/arch/arm64/Kconfig
@@ -2200,6 +2200,12 @@ config CMDLINE_FROM_BOOTLOADER
          the boot loader doesn't provide any, the default kernel command
          string provided in CMDLINE will be used.
 
+config CMDLINE_EXTEND
+       bool "Extend bootloader kernel arguments"
+       help
+         The command-line arguments provided by the boot loader will be
+         appended to the default kernel command string.
+
 config CMDLINE_FORCE
        bool "Always use the default kernel command string"
        help
```
