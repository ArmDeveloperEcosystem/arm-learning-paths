## CMakeLists.txt
```
# SPDX-License-Identifier: Apache-2.0
cmake_minimum_required(VERSION 3.20.0)
find_package(Zephyr REQUIRED HINTS $ENV{ZEPHYR_BASE})
project(pb2_m4_heartbeat)
target_sources(app PRIVATE src/main.c src/resource_table.c)
```

## prj.conf
```kconfig
CONFIG_PRINTK=y
CONFIG_CONSOLE=y
CONFIG_SERIAL=y
CONFIG_UART_CONSOLE=y
CONFIG_MAIN_STACK_SIZE=1024
```

## src/main.c
```c
/* SPDX-License-Identifier: Apache-2.0 */
#include <zephyr/kernel.h>
#include <zephyr/sys/printk.h>

int main(void)
{
    unsigned int count = 0;

    printk("PocketBeagle 2: Zephyr on Cortex-M4F\n");
    while (1) {
        printk("M4 heartbeat %u\n", count++);
        k_sleep(K_SECONDS(1));
    }
    return 0;
}
```

## src/resource_table.c
```c
/* SPDX-License-Identifier: Apache-2.0 */
#include <stdint.h>

/* Linux remoteproc table version 1, with no RPMsg devices or trace entries. */
static const struct {
    uint32_t version;
    uint32_t num;
    uint32_t reserved[2];
} resource_table __attribute__((section(".resource_table"), used, aligned(4))) = {
    .version = 1,
    .num = 0,
    .reserved = { 0, 0 },
};
```
